## board/freescale/imx8qm_rom7720_a1/Kconfig
```kconfig
if TARGET_IMX8QM_ROM7720A1_2G || TARGET_IMX8QM_ROM7720A1_4G

config SYS_BOARD
	default "imx8qm_rom7720_a1"

config SYS_VENDOR
	default "freescale"

config SYS_CONFIG_NAME
	default "imx8qm_rom7720"

source "board/freescale/common/Kconfig"

endif
```
